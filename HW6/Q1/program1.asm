.include "m32def.inc"
		LDI		R16,HIGH(RAMEND)
		OUT		SPH,R16
		LDI		R16,LOW(RAMEND)
		OUT		SPL,R16

		LDI		R16,0xFF
		OUT		DDRA,R16	
		OUT		DDRC,R16		

Round:
		LDI		R16,1			;Yekan Fibo(t)
		LDI		R17,0			;Dahgan Fibo(t) 
		LDI		R18,0			;Yekan Fibo(t - 1)
		LDI		R19,0			;Dahgan Fibo(t - 1)
		RJMP	DISPLAY

HERE: 
		MOV		R26, R18
		MOV		R27, R19
		MOV		R18, R16
		MOV		R19, R17

		CALL	DECREMENT

INCREMENT:
		CPI		R16,9
		BRLO	INC_YEKAN
		CPI		R17,9
		BRLO	INC_DAHGAN
		RJMP	Round

DECREMENT:
		CPI		R26,1
		BRSH	DEC_YEKAN
		CPI		R27,1
		BRSH	DEC_DAHGAN
		RJMP	DISPLAY

INC_YEKAN:
		INC		R16
		RJMP	DECREMENT

INC_DAHGAN:
		LDI		R16,0
		INC		R17
		RJMP	DECREMENT

DEC_YEKAN:
		DEC		R26
		RJMP	INCREMENT

DEC_DAHGAN:
		LDI		R26,9
		DEC		R27
		RJMP	INCREMENT

DISPLAY:
		OUT		PORTC,R17
		OUT		PORTA,R16

		CALL	DELAY_DISP

		RJMP	HERE

DELAY_DISP:
		LDI		R21,0x02
L4:		LDI		R22,0xFF
L5:		LDI		R23,0xFF
L6:		DEC		R23
		BRNE	L6
		DEC		R22
		BRNE	L5
		DEC		R21
		BRNE	L4
		RET
